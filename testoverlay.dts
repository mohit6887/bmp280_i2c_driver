/dts-v1/;
/plugin/;
/ {
	compatible = "brcm,bcm2835";
	fragment@0 {
		target = <&i2c1>;
		__overlay__ {
			#address-cells = <1>;
			#size-cells = <0>;

			mohit280: mohit280@76 {
				compatible = "brightlight,mohit280";
				reg = <0x76>;
				status = "okay";
			};
		};
	};
};
